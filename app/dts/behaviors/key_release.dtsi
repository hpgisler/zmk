/*
 * Copyright (c) 2020 The ZMK Contributors
 *
 * SPDX-License-Identifier: MIT
 */

/ {
    behaviors {
        /omit-if-no-ref/ kr: behavior_key_release {
            compatible = "zmk,behavior-key-release";
            label = "KEY_RELEASE";
            #binding-cells = <1>;
        };
    };
};
