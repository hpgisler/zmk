## app/dts/bindings/behaviors/zmk,behavior-key-release.yaml
```yaml
# Copyright (c) 2020 The ZMK Contributors
# SPDX-License-Identifier: MIT

description: Key press/release behavior

compatible: "zmk,behavior-key-release"

include: one_param.yaml
```

## app/dts/bindings/zmk,delay.yaml
```yaml
# Copyright (c) 2020, The ZMK Contributors
# SPDX-License-Identifier: MIT

description: Delay key-presses for all non-layer key positions

compatible: "zmk,delay"

child-binding:
  description: "A key-press delay"

  properties:
    layer-key-positions:
      type: array
      required: true
    timeout-ms:
      type: int
      default: 50
```
